## Lhand/boards/shields/DecaDeca_Split/Kconfig.defconfig
```kconfig
if SHIELD_DECADECA_SPLIT_LEFT

config ZMK_KEYBOARD_NAME
    default "DecaDeca_Split"

config ZMK_SPLIT_ROLE_CENTRAL
    default y

endif

if SHIELD_DECADECA_SPLIT_LEFT || SHIELD_DECADECA_SPLIT_RIGHT

config ZMK_SPLIT
    default y

endif
```

## boards/shields/DecaDeca_Split/Kconfig.shield
```kconfig
config SHIELD_DECADECA_SPLIT_LEFT
    def_bool $(shields_list_contains,DecaDeca_Split_left)

config SHIELD_DECADECA_SPLIT_RIGHT
    def_bool $(shields_list_contains,DecaDeca_Split_right)
```
