#include "DecaDeca_Split.dtsi" 

&default_transform { 
    col-offset = <6>;
};


&kscan0 {
  col-gpios
     = <&pro_micro 18 GPIO_ACTIVE_HIGH>  // COL0
      , <&pro_micro 15 GPIO_ACTIVE_HIGH> // COL1
      , <&pro_micro 14 GPIO_ACTIVE_HIGH> // COL2
      , <&pro_micro 16 GPIO_ACTIVE_HIGH> // COL3
      , <&pro_micro 10 GPIO_ACTIVE_HIGH> // COL4
      , <&pro_micro 8 GPIO_ACTIVE_HIGH>  // COL5
      ;
};